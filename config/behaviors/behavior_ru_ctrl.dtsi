/ {
  behaviors {
    /* Russian layer: hold Ctrl → momentary CtrlColemak (9) + LCTRL; OS lang unchanged */
    ru_ctrl: ru_ctrl {
      compatible = "zmk,behavior-macro";
      label = "RU_CTRL";
      #binding-cells = <0>;
      bindings =
        <&macro_press &mo 9 &kp LCTRL>
      , <&macro_pause_for_release>
      , <&macro_release &kp LCTRL &mo 9>;
    };
  };
};

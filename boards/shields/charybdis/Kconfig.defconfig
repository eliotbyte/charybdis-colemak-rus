## boards/shields/charybdis/Kconfig.defconfig
```kconfig
if SHIELD_CHARYBDIS_DONGLE

config ZMK_KEYBOARD_NAME
	default "Charybdis"

config ZMK_SPLIT_ROLE_CENTRAL
	default y

endif

if SHIELD_CHARYBDIS_DONGLE || SHIELD_CHARYBDIS_LEFT || SHIELD_CHARYBDIS_RIGHT

config ZMK_SPLIT
	default y
	
endif

if SHIELD_CHARYBDIS_DONGLE

config ZMK_AUTO_MOUSE_LAYER
	bool "Smart auto mouse layer"
	default y

config ZMK_AUTO_MOUSE_TIMEOUT_MS
	int "Mouse layer idle timeout (ms)"
	default 500
	depends on ZMK_AUTO_MOUSE_LAYER

config ZMK_AUTO_MOUSE_KB_LOCK_MS
	int "Keyboard lock duration (ms)"
	default 500
	depends on ZMK_AUTO_MOUSE_LAYER

config ZMK_LANG_SWITCH_FREEZE
	bool "Freeze input during OS language switch (Lower/Raise)"
	default y

config ZMK_LANG_SWITCH_LOWER_POS
	int "Key position for &mo LOWER thumb key"
	default 37
	depends on ZMK_LANG_SWITCH_FREEZE

config ZMK_LANG_SWITCH_RAISE_POS
	int "Key position for &mo RAISE thumb key"
	default 40
	depends on ZMK_LANG_SWITCH_FREEZE

config ZMK_LANG_SWITCH_RUSSIAN_LAYER
	int "ZMK layer index for Russian (restore OS lang on release)"
	default 1
	depends on ZMK_LANG_SWITCH_FREEZE

config ZMK_LANG_SWITCH_COMBO_MS
	int "Time for Alt+Shift+N HID sequence (ms)"
	default 35
	depends on ZMK_LANG_SWITCH_FREEZE

config ZMK_LANG_SWITCH_FREEZE_MS
	int "Drop input after layer key press (ms)"
	default 50
	depends on ZMK_LANG_SWITCH_FREEZE

endif
```

## config/west.yml
```yaml
manifest:
  remotes:
    - name: zmkfirmware
      url-base: https://github.com/zmkfirmware
    - name: badjeff
      url-base: https://github.com/badjeff
    - name: carrefinho
      url-base: https://github.com/carrefinho
    - name: oleksandrmaslov
      url-base: https://github.com/oleksandrmaslov
    - name: kot149
      url-base: https://github.com/kot149
  projects:
    - name: zmk
      remote: zmkfirmware
      revision: main
      import: app/west.yml
    - name: zmk-pmw3610-driver
      remote: badjeff
      revision: zmk-0.4
    - name: prospector-zmk-module
      remote: carrefinho
      revision: feat/new-status-screens
    - name: zmk-pointing-acceleration
      remote: oleksandrmaslov
      revision: main
    - name: zmk-scroll-snap
      remote: kot149
      revision: v1
  self:
    path: config
```

## zmk_extra_modules/auto_mouse_layer/Kconfig
```kconfig
config ZMK_AUTO_MOUSE_LAYER
    bool "Smart auto mouse layer"
    default y

config ZMK_AUTO_MOUSE_TIMEOUT_MS
    int "Mouse layer idle timeout (ms)"
    default 500
    depends on ZMK_AUTO_MOUSE_LAYER

config ZMK_AUTO_MOUSE_KB_LOCK_MS
    int "Keyboard lock duration (ms)"
    default 500
    depends on ZMK_AUTO_MOUSE_LAYER
```

## zmk_extra_modules/lang_switch_freeze/Kconfig
```kconfig
config ZMK_LANG_SWITCH_FREEZE
    bool "Freeze input during OS language switch (Lower/Raise)"
    default y

config ZMK_LANG_SWITCH_LOWER_POS
    int "Key position for &mo LOWER thumb key"
    default 37
    depends on ZMK_LANG_SWITCH_FREEZE

config ZMK_LANG_SWITCH_RAISE_POS
    int "Key position for &mo RAISE thumb key"
    default 40
    depends on ZMK_LANG_SWITCH_FREEZE

config ZMK_LANG_SWITCH_RUSSIAN_LAYER
    int "ZMK layer index for Russian (restore OS lang on release)"
    default 1
    depends on ZMK_LANG_SWITCH_FREEZE

config ZMK_LANG_SWITCH_COMBO_MS
    int "Time for Alt+Shift+N HID sequence (ms)"
    default 35
    depends on ZMK_LANG_SWITCH_FREEZE

config ZMK_LANG_SWITCH_FREEZE_MS
    int "Drop input after layer key press (ms)"
    default 50
    depends on ZMK_LANG_SWITCH_FREEZE
```
